## config/boards/shields/nilsers44s/Kconfig.defconfig
```kconfig
if SHIELD_NILSERS44S_LEFT

config ZMK_KEYBOARD_NAME
    default "nilsers44s"

endif


if SHIELD_NILSERS44S_LEFT || SHIELD_NILSERS44S_RIGHT

config ZMK_SPLIT
    default y

endif
```

## config/boards/shields/nilsers44s/Kconfig.shield
```kconfig
config SHIELD_NILSERS44S_LEFT
    def_bool $(shields_list_contains, nilsers44s_left)

config SHIELD_NILSERS44S_RIGHT
    def_bool $(shields_list_contains, nilsers44s_right)
```
